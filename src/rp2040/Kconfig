## src/rp2040/Kconfig
```kconfig
# Kconfig settings for RP2040 processors

if MACH_RP2040

config RP2040_SELECT
    bool
    default y
    select HAVE_GPIO
    select HAVE_GPIO_ADC
    select HAVE_GPIO_SPI
    select HAVE_GPIO_I2C
    select HAVE_GPIO_BITBANGING
    select HAVE_STRICT_TIMING
    select HAVE_CHIPID
    select HAVE_GPIO_HARD_PWM
    select HAVE_STEPPER_BOTH_EDGE

config BOARD_DIRECTORY
    string
    default "rp2040"

config MCU
    string
    default "rp2040"

config CLOCK_FREQ
    int
    default 12000000

config FLASH_SIZE
    hex
    default 0x200000

config FLASH_BOOT_ADDRESS
    hex
    default 0x10000100 # Stage2 binary starts at 0x10000000

config RAM_START
    hex
    default 0x20000000

config RAM_SIZE
    hex
    default 0x42000

config STACK_SIZE
    int
    default 512


######################################################################
# Bootloader options
######################################################################

config RP2040_HAVE_STAGE2
    bool
config RP2040_HAVE_BOOTLOADER
    bool
    default y if !RP2040_HAVE_STAGE2

choice
    prompt "Bootloader offset"
    config RP2040_FLASH_START_0100
        bool "No bootloader"
        select RP2040_HAVE_STAGE2
    config RP2040_FLASH_START_4000
        bool "16KiB bootloader"
endchoice
config FLASH_START
    hex
    default 0x10004000 if RP2040_FLASH_START_4000
    default 0x10000100

choice
    prompt "Flash chip" if LOW_LEVEL_OPTIONS && RP2040_HAVE_STAGE2
    config RP2040_FLASH_W25Q080
        bool "W25Q080 with CLKDIV 2"
    config RP2040_FLASH_GENERIC_03
        bool "GENERIC_03H with CLKDIV 4"
endchoice

config RP2040_STAGE2_FILE
    string
    default "boot2_generic_03h.S" if RP2040_FLASH_GENERIC_03
    default "boot2_w25q080.S"

config RP2040_STAGE2_CLKDIV
    int
    default 4 if RP2040_FLASH_GENERIC_03
    default 2


######################################################################
# Communication inteface
######################################################################

choice
    prompt "Communication interface"
    config RP2040_USB
        bool "USB"
        select USBSERIAL
    config RP2040_SERIAL_UART0
        bool "Serial (on UART0 GPIO1/GPIO0)"
        select SERIAL
    config RP2040_CANBUS
        bool "CAN bus"
        select CANSERIAL
    config RP2040_USBCANBUS
        bool "USB to CAN bus bridge"
        select USBCANBUS
endchoice

config RP2040_CANBUS_GPIO_RX
    int "CAN RX gpio number" if CANBUS
    default 4
    range 0 29

config RP2040_CANBUS_GPIO_TX
    int "CAN TX gpio number" if CANBUS
    default 5
    range 0 29

config BLDC
    bool "Enable BLDC motor support for RP2040 and Simple FOC Shield"
    default n
    help
        Enable BLDC motor support for RP2040 and Simple FOC Shield

menu "BLDC"
depends on BLDC

choice
    prompt "GPIO pin for BLDC Motor 0 PWM A"
    depends on BLDC
    config BLDC_PWM0A_0
        bool "gpio0"
    config BLDC_PWM0A_1
        bool "gpio1"
    config BLDC_PWM0A_2
        bool "gpio2"
    config BLDC_PWM0A_3
        bool "gpio3"
    config BLDC_PWM0A_4
        bool "gpio4"
    config BLDC_PWM0A_5
        bool "gpio5"
    config BLDC_PWM0A_6
        bool "gpio6"
    config BLDC_PWM0A_7
        bool "gpio7"
    config BLDC_PWM0A_8
        bool "gpio8"
    config BLDC_PWM0A_9
        bool "gpio9"
    config BLDC_PWM0A_10
        bool "gpio10"
    config BLDC_PWM0A_11
        bool "gpio11"
    config BLDC_PWM0A_12
        bool "gpio12"
    config BLDC_PWM0A_13
        bool "gpio13"
    config BLDC_PWM0A_14
        bool "gpio14"
    config BLDC_PWM0A_15
        bool "gpio15"
endchoice

config BLDC_PWM0A
    int
    default 0 if BLDC_PWM0A_0
    default 1 if BLDC_PWM0A_1
    default 2 if BLDC_PWM0A_2
    default 3 if BLDC_PWM0A_3
    default 4 if BLDC_PWM0A_4
    default 5 if BLDC_PWM0A_5
    default 6 if BLDC_PWM0A_6
    default 7 if BLDC_PWM0A_7
    default 8 if BLDC_PWM0A_8
    default 9 if BLDC_PWM0A_9
    default 10 if BLDC_PWM0A_10
    default 11 if BLDC_PWM0A_11
    default 12 if BLDC_PWM0A_12
    default 13 if BLDC_PWM0A_13
    default 14 if BLDC_PWM0A_14
    default 15 if BLDC_PWM0A_15
  
choice
    prompt "GPIO pin for BLDC Motor 0 PWM B"
    depends on BLDC
    config BLDC_PWM0B_1
        bool "gpio1"
    config BLDC_PWM0B_0
        bool "gpio0"
    config BLDC_PWM0B_2
        bool "gpio2"
    config BLDC_PWM0B_3
        bool "gpio3"
    config BLDC_PWM0B_4
        bool "gpio4"
    config BLDC_PWM0B_5
        bool "gpio5"
    config BLDC_PWM0B_6
        bool "gpio6"
    config BLDC_PWM0B_7
        bool "gpio7"
    config BLDC_PWM0B_8
        bool "gpio8"
    config BLDC_PWM0B_9
        bool "gpio9"
    config BLDC_PWM0B_10
        bool "gpio10"
    config BLDC_PWM0B_11
        bool "gpio11"
    config BLDC_PWM0B_12
        bool "gpio12"
    config BLDC_PWM0B_13
        bool "gpio13"
    config BLDC_PWM0B_14
        bool "gpio14"
    config BLDC_PWM0B_15
        bool "gpio15"
endchoice

config BLDC_PWM0B
    int
    default 0 if BLDC_PWM0B_0
    default 1 if BLDC_PWM0B_1
    default 2 if BLDC_PWM0B_2
    default 3 if BLDC_PWM0B_3
    default 4 if BLDC_PWM0B_4
    default 5 if BLDC_PWM0B_5
    default 6 if BLDC_PWM0B_6
    default 7 if BLDC_PWM0B_7
    default 8 if BLDC_PWM0B_8
    default 9 if BLDC_PWM0B_9
    default 10 if BLDC_PWM0B_10
    default 11 if BLDC_PWM0B_11
    default 12 if BLDC_PWM0B_12
    default 13 if BLDC_PWM0B_13
    default 14 if BLDC_PWM0B_14
    default 15 if BLDC_PWM0B_15


choice
    prompt "GPIO pin for BLDC Motor 0 PWM C"
    depends on BLDC
    config BLDC_PWM0C_2
        bool "gpio2"
    config BLDC_PWM0C_0
        bool "gpio0"
    config BLDC_PWM0C_1
        bool "gpio1"
    config BLDC_PWM0C_3
        bool "gpio3"
    config BLDC_PWM0C_4
        bool "gpio4"
    config BLDC_PWM0C_5
        bool "gpio5"
    config BLDC_PWM0C_6
        bool "gpio6"
    config BLDC_PWM0C_7
        bool "gpio7"
    config BLDC_PWM0C_8
        bool "gpio8"
    config BLDC_PWM0C_9
        bool "gpio9"
    config BLDC_PWM0C_10
        bool "gpio10"
    config BLDC_PWM0C_11
        bool "gpio11"
    config BLDC_PWM0C_12
        bool "gpio12"
    config BLDC_PWM0C_13
        bool "gpio13"
    config BLDC_PWM0C_14
        bool "gpio14"
    config BLDC_PWM0C_15
        bool "gpio15"
endchoice

config BLDC_PWM0C
    int
    default 0 if BLDC_PWM0C_0
    default 1 if BLDC_PWM0C_1
    default 2 if BLDC_PWM0C_2
    default 3 if BLDC_PWM0C_3
    default 4 if BLDC_PWM0C_4
    default 5 if BLDC_PWM0C_5
    default 6 if BLDC_PWM0C_6
    default 7 if BLDC_PWM0C_7
    default 8 if BLDC_PWM0C_8
    default 9 if BLDC_PWM0C_9
    default 10 if BLDC_PWM0C_10
    default 11 if BLDC_PWM0C_11
    default 12 if BLDC_PWM0C_12
    default 13 if BLDC_PWM0C_13
    default 14 if BLDC_PWM0C_14
    default 15 if BLDC_PWM0C_15

config BLDC_POWER0
    depends on BLDC
    int "BLDC Motor 0 max. PWM power in percent"
    default 60
    help
        BLDC Motor 0 max. PWM power in percent

config BLDC_POWER0_HOLDING
    depends on BLDC
    int "BLDC Motor 0 holding PWM power in percent from max. PWM power"
    default 40
    help
        BLDC Motor 0 holding PWM power in percent from max. PWM power


endmenu

endif
```
